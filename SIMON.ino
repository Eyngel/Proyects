#include <stdlib.h>
#define MAX 50    //Max number of games

unsigned char i;
int j[MAX];
unsigned char n;
unsigned char k;

/*Port Definitions*/
int Max7219_pinCLK = 4;
int Max7219_pinCS = 3;
int Max7219_pinDIN = 2;

unsigned char disp1[16][8]={        //switched leds on matrix
{0xC0,0xC0,0x0,0x0,0x0,0x0,0x0,0x0},//0
{0x30,0x30,0x0,0x0,0x0,0x0,0x0,0x0},//1
{0xC,0xC,0x0,0x0,0x0,0x0,0x0,0x0},//2
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{0x0,0x0,0x0,0x0,0x0,0x0,0x3,0x3},//15
};

void Write_Max7219_byte(unsigned char DATA){
    unsigned char i;
    digitalWrite(Max7219_pinCS,LOW);
       for(i=8;i>=1;i--){
          digitalWrite(Max7219_pinCLK,LOW);
          digitalWrite(Max7219_pinDIN,DATA&0x80);// Extracting a bit data
          DATA = DATA<<1;
          digitalWrite(Max7219_pinCLK,HIGH);
       }
}

void Write_Max7219(unsigned char address,unsigned char dat){
      digitalWrite(Max7219_pinCS,LOW);
      Write_Max7219_byte(address); //address，code of LED
      Write_Max7219_byte(dat); //data，figure on LED
      digitalWrite(Max7219_pinCS,HIGH);
}

void Init_MAX7219(void){
      Write_Max7219(0x09, 0x00); //decoding ：BCD
      Write_Max7219(0x0a, 0x00); //brightness (0x00 to 0x05)
      Write_Max7219(0x0b, 0x07); //scanlimit；8 LEDs
      Write_Max7219(0x0c, 0x01); //power-down mode：0，normal mode：1
      Write_Max7219(0x0f, 0x00); //test display：1；EOT，display：0
    }

void setup(){
      Serial.begin(9600);
      pinMode(Max7219_pinCLK,OUTPUT);
      pinMode(Max7219_pinCS,OUTPUT);
      pinMode(Max7219_pinDIN,OUTPUT);
      delay(50);
      Init_MAX7219();
}

void loop(){
      for(n=0;n<MAX;n++){
      k = 1000/(n^(1/8));    //increases velocity decreasing delay
      j[n] = rand() % 16;    //gets random number
          for(i=1;i<9;i++)
              Write_Max7219(i,disp1[j[n]][i-1]);
              Serial.print(j[n]);  //ploting (test mode)
              delay(k);
          }
}
